## zephyr/Kconfig
```kconfig
# Copyright (c) 2022 Space Cubics, LLC.
# SPDX-License-Identifier: Apache-2.0

config LIBJANSSON2
    bool "Enable jansson2"
    help
      This option enables the jansson2 as a Zephyr module.

config APP_LINK_WITH_JANSSON2
    bool "Make jansson2 header file available to application"
    default y
    depends on LIBJANSSON2
```
